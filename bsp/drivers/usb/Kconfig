## bsp/drivers/usb/Kconfig
```kconfig
# SPDX-License-Identifier: GPL-2.0
#
# USB configuration
#

if AW_BSP && USB_SUPPORT

if USB

source "bsp/drivers/usb/host/Kconfig"

endif # USB

source "bsp/drivers/usb/sunxi_usb/Kconfig"

endif # USB_SUPPORT
```

## bsp/drivers/video/sunxi/disp2/disp/Kconfig
```kconfig
# SPDX-License-Identifier: GPL-2.0-or-later
config AW_DISP2_SUPPORT_SMBL
	bool "Support smart backlight"
	default y
	help
		If you want to support smart backlight, select it.

config AW_DISP2_SUPPORT_ENAHNCE
	bool "Support Video Enhance Process"
	default y
	help
		If you want to support video enhance process, select it.

config AW_DISP2_DEVICE_OFF_ON_RELEASE
	bool "Clear all layers and turn off display device on /dev/disp release"
	default y
	help
		Select it to enable this feature.
```

## bsp/drivers/vin/Kconfig
```kconfig
# SPDX-License-Identifier: GPL-2.0-only
menu "VIN (camera) Drivers"
	depends on AW_BSP

config AW_VIDEO_SUNXI_VIN
       tristate "sunxi video input (camera csi/mipi isp vipp) driver"
	   select MEDIA_SUPPORT
       default n

config AW_SENSOR_POWER
       tristate "sensor power in front of vin"
       depends on AW_VIDEO_SUNXI_VIN
       default n
config CSI_VIN
	tristate "v4l2 new driver for SUNXI"
	depends on AW_VIDEO_SUNXI_VIN
	default m
	select VIDEOBUF2_DMA_CONTIG

config ENABLE_SENSOR_FLIP_OPTION
	bool "select sensor flip to replace vipp flip"
	depends on AW_VIDEO_SUNXI_VIN
	default n
	help
	   you cant flip in vipp when you select LBC format,
	   so you can enable it to active sensor flip operation.

config CSI_CCI
	tristate "use cci function"
	depends on AW_VIDEO_SUNXI_VIN
	default n
	help
		CCI is a hardware module in CSI. you can make it to
		be cci or i2c in the system.

if CSI_CCI
source "bsp/drivers/vin/vin-cci/Kconfig"
endif

config FLASH
	tristate "use flash module"
	depends on AW_VIDEO_SUNXI_VIN
	default m

config ACTUATOR
	tristate "use actuator module"
	depends on AW_VIDEO_SUNXI_VIN
	default m

config SENSOR_LIST
	tristate "sensor list for adaptive"
	depends on AW_VIDEO_SUNXI_VIN
	default m

config BUF_AUTO_UPDATE
	bool "buf addr update for hardware"
	depends on AW_VIDEO_SUNXI_VIN
	default n

config VIN_LOG
	bool "use vin log for debug"
	depends on AW_VIDEO_SUNXI_VIN
	default y

config PIPELINE_RESET
	bool "use pipeline reset when timeout"
	depends on AW_VIDEO_SUNXI_VIN
	default n

config MULTI_FRAME
	bool "multi-frame interrupt mode"
	depends on AW_VIDEO_SUNXI_VIN
	default n

config SUPPORT_ISP_TDM
	bool "use isp for time sharing multiplex"
	depends on AW_VIDEO_SUNXI_VIN
	default n

config DISPPLAY_SYNC
	bool "use one buffer for delay display"
	depends on AW_VIDEO_SUNXI_VIN
	default n

config VIN_IOMMU
	bool "use IOMMU for memery alloc"
	depends on AW_VIDEO_SUNXI_VIN
	default y

config D3D
	bool "ISP 3D denoise module"
	depends on AW_VIDEO_SUNXI_VIN
	default n

config D3D_LTF_EN
	bool "ISP 3D denoise long time frame"
	depends on D3D
	depends on AW_VIDEO_SUNXI_VIN
	default n

config D3D_COMPRESS_EN
	bool "ISP 3D denoise reduces buf size by compression"
	depends on AW_VIDEO_SUNXI_VIN
	depends on D3D
	default	n

config WDR
	bool "ISP WDR module"
	depends on AW_VIDEO_SUNXI_VIN
	default n

config WDR_COMPRESS_EN
	bool "ISP WDR reduces buf size by compression"
	depends on AW_VIDEO_SUNXI_VIN
	depends on WDR
	default	n

config SAME_I2C
	bool "sensor same i2c addr"
	depends on AW_VIDEO_SUNXI_VIN
	default y

endmenu
```

## bsp/modules/debug/Kconfig
```kconfig
# SPDX-License-Identifier: GPL-2.0-only
menu "One-key Debug"
	depends on AW_BSP

config AW_LOCK_DEBUG
	tristate "One-key LOCK DEBUG"
	select DETECT_HUNG_TASK
	select DEBUG_RT_MUTEXES
	select DEBUG_MUTEXES
	select DEBUG_WW_MUTEX_SLOWPATH
	select DEBUG_SPINLOCK
	select DEBUG_LOCK_ALLOC
	select PROVE_LOCKING
	select LOCKDEP
	select LOCK_STAT
	select DEBUG_LOCKDEP
	select DEBUG_ATOMIC_SLEEP
	help
	  Support one-key lock debug.
	  Say Y here, you can enable the lock debug functions at one time.

config AW_MEM_DEBUG
	tristate "One-key MEMORY DEBUG"
	select DEBUG_PAGEALLOC
	select DEBUG_PAGEALLOC_ENABLE_DEFAULT
	select PAGE_OWNER
	select PAGE_POISONING
	select DEBUG_WX
	select SLUB_DEBUG_ON
	select SLUB_STATS
	select DEBUG_KMEMLEAK
	select SCHED_STACK_END_CHECK
	select DEBUG_VM
	help
	  Support one-key memory debug.
	  Say Y here, you can enable the memory debug functions at one time.

config AW_FTRACE
	tristate "One-key FTRACE"
	select BOOTTIME_TRACING
	select FUNCTION_TRACER
	select FUNCTION_PROFILER
	select FTRACE_SYSCALLS
	help
	  Support one-key ftrace.
	  Say Y here, you can enable the ftrace functions at one time.

endmenu
```

## bsp/modules/nand/Kconfig
```kconfig
menu "NAND Drivers"
	depends on AW_BSP

config AW_NAND
	tristate  "The sunxi nand driver"
	default n
	depends on (AW_SID)
	help
	  The nand used on the platform.

	  If unsure, say m.
source "bsp/modules/nand/common1/Kconfig"

endmenu
```

## bsp/modules/nand/common1/Kconfig
```kconfig
choice
	prompt "choice spinand or rawnand"
	depends on (AW_NAND)

	config AW_RAWNAND
		bool "sunxi raw nand driver"

	config	AW_SPINAND
		bool "sunxi spi nand driver"

endchoice

config AW_RAWNAND_CD
	bool "sunxi rawnand exteral module detect unclean poweroff"
	depends on SUNXI_RAWNAND
	help
	exteral module detect unclean poweroff(e.g. powerdown),then it send a
	signal to gpio,gpio generate signal to stop ndfc work.
	this should be support by hardware circuit.

	if you enable it, and you should configure property cd-debounce-delay-ms and
	pwroff-gpios in dts

	  WARNING: the gpio can't be used by other
```

## bsp/platform/Kconfig
```kconfig
# SPDX-License-Identifier: GPL-2.0-only

source "bsp/platform/Kconfig.common"

menu "Platform Selection"

config AW_BSP
	bool "Allwinner Platform"
	select ARCH_SUNXI
	select ARCH_HAS_RESET_CONTROLLER
	select GENERIC_IRQ_CHIP
	select PINCTRL
	select RESET_CONTROLLER
	help
	  This enables support for Allwinner sunxi based SoCs like the A64.

choice
	prompt "Select SoC Family"
	default ARCH_SUN8I  if ARM
	default ARCH_SUN50I if ARM64
	default ARCH_SUN20I if RISCV
	depends on AW_BSP
	help
	  Select the Family for SoC

config ARCH_SUN8I
	bool "Allwinner SUN8I"
	depends on AW_BSP && ARM
	help
	  Allwinner SUN8I SoC Family

config ARCH_SUN50I
	bool "Allwinner SUN50I"
	depends on AW_BSP
	#select xxx if ARM
	#select xxx64 if ARM64
	help
	  Allwinner SUN50I SoC Family

config ARCH_SUN55I
	bool "Allwinner SUN55I"
	depends on AW_BSP && ARM64
	help
	  Allwinner SUN55I SoC Family

config ARCH_SUN20I
	bool "Allwinner SUN20I"
	depends on AW_BSP && RISCV
	help
	  Allwinner SUN20I SoC Family

endchoice

choice
	prompt "Select the Wafer"
	default ARCH_SUN50IW10
	depends on AW_BSP
	help
	  Select the wafer

config ARCH_SUN55IW2
	bool "SUN55IW2"
	depends on ARCH_SUN55I
	help
	  Support for Allwinner SUN55IW2 SoC

config ARCH_SUN55IW3
	bool "SUN55IW3"
	depends on ARCH_SUN55I
	help
	  Support for Allwinner SUN55IW3 SoC

config ARCH_SUN50IW9
	bool "SUN50IW9"
	depends on ARCH_SUN50I
	help
	  Support for Allwinner SUN50IW9 SoC

config ARCH_SUN50IW10
	bool "SUN50IW10"
	depends on ARCH_SUN50I
	help
	  Support for Allwinner SUN50IW10 SoC

config ARCH_SUN50IW12
	bool "SUN50IW12"
	depends on ARCH_SUN50I
	help
	  Support for Allwinner SUN50IW12 SoC

config ARCH_SUN8IW11
	bool "SUN8IW11"
	depends on ARCH_SUN8I
	help
	  Support for Allwinner SUN8IW11 SoC

endchoice

choice
	prompt "Select the SoC"
	help
	 Select the SoC

config ARCH_SUN60IW1P1
	depends on ARCH_SUN60IW1
	bool "Allwinner SUN60IW1P1"

config ARCH_SUN50IW10P1
	depends on ARCH_SUN50IW10
	bool "Allwinner SUN50IW10P1"
endchoice

choice
	prompt "Select the Board"
	depends on AW_BSP
	default AW_FPGA_S4

config AW_FPGA_S4
	bool "FPGA S4 Board"
	help
	  Support for Allwinner FPGA S4 board

config AW_FPGA_V7
	bool "FPGA V7 Board"
	help
	  Support for Allwinner FPGA V7 board

config AW_IC_BOARD
	bool "IC Board"
	help
	  Support for Allwinner IC board
endchoice

config AW_SOC_NAME
	string "SoC Name"
	default ""
	depends on AW_BSP
	help
	  Used by sysfs: /sys/.../sysinfo

endmenu
```
