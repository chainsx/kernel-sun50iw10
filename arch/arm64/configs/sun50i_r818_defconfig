## arch/arm64/configs/sun50i_r818_defconfig
```kconfig
CONFIG_AW_BSP=y
CONFIG_AW_IC_BOARD=y
CONFIG_AW_SOC_NAME="R818"
CONFIG_AW_TIMER=y
CONFIG_AW_TIMER_SUN50I=y
CONFIG_AW_DMA=y
CONFIG_AW_RTC=y
CONFIG_AW_NSI=y
CONFIG_AW_WATCHDOG=y
CONFIG_AW_I2C=y
CONFIG_AW_SPI=y
CONFIG_AW_PWM=y
CONFIG_AW_IR_TX=m
CONFIG_AW_IR_RX=m
CONFIG_USB_EHCI_HCD_SUNXI=y
CONFIG_USB_OHCI_HCD_SUNXI=y
CONFIG_USB_SUNXI_HCD=y
CONFIG_USB_SUNXI_HCI=y
CONFIG_USB_SUNXI_EHCI0=y
CONFIG_USB_SUNXI_EHCI1=y
CONFIG_USB_SUNXI_OHCI0=y
CONFIG_USB_SUNXI_OHCI1=y
CONFIG_USB_SUNXI_USB=y
CONFIG_USB_SUNXI_USB_MANAGER=y
CONFIG_USB_SUNXI_USB_DEBUG=y
CONFIG_USB_SUNXI_USB_ADB=y
CONFIG_USB_SUNXI_UDC0=y
CONFIG_AW_IOMMU=y
CONFIG_AW_GMAC=y
CONFIG_AW_GMAC_METADATA=y
CONFIG_AW_WAKEUPGEN=y
CONFIG_AW_SUN8I_NMI=y
CONFIG_AW_THERMAL=y
CONFIG_NVMEM_AW_SID=y
CONFIG_AW_MFD_AXP2101_I2C=y
CONFIG_AW_MFD_PMU_EXT_I2C=y
CONFIG_AW_REGULATOR_AXP2101=y
CONFIG_AW_REGULATOR_PMU_EXT=y
CONFIG_AW_INPUT_AXP2101_PEK=y
CONFIG_AW_AXP2202_POWER=y
CONFIG_AW_CPUFREQ_DT=y
CONFIG_ARM_AW_SUN50I_CPUFREQ_NVMEM=y
CONFIG_AW_INPUT_SENSORINIT=y
CONFIG_AW_INPUT_CTP=y
# CONFIG_TOUCHSCREEN_GSLX680NEW is not set
CONFIG_AW_INPUT_SENSOR=y
CONFIG_AW_MMC=y
CONFIG_AW_G2D=y
CONFIG_G2D_SYNCFENCE=y
CONFIG_AW_VIDEO_SUNXI_VIN=y
CONFIG_SND_SOC_AC107=y
CONFIG_SND_SOC_SUNXI_AAUDIO=y
CONFIG_SND_SOC_SUNXI_JACK_CODEC=y
CONFIG_SND_SOC_SUNXI_COMPONENTS=y
CONFIG_SND_SOC_SUNXI_DEBUG=y
CONFIG_AW_SYS_INFO=y
CONFIG_AW_SMC=y
CONFIG_AW_SID=y
CONFIG_AIC_WLAN_SUPPORT=y
CONFIG_AIC_FW_PATH="/lib/firmware/aic8800/SDIO/aic8800DC"
CONFIG_AIC8800_WLAN_SUPPORT=m
CONFIG_AIC8800_BTLPM_SUPPORT=m
CONFIG_BT_RTKBTUSB=m
CONFIG_SUNXI_DIRECT_GPIO=y
CONFIG_AW_RFKILL=m
CONFIG_AW_MACADDR_MGT=m
CONFIG_AW_CRASHDUMP=y
# CONFIG_LOCALVERSION_AUTO is not set
CONFIG_NO_HZ=y
CONFIG_HIGH_RES_TIMERS=y
CONFIG_PREEMPT=y
CONFIG_IKCONFIG=y
CONFIG_IKCONFIG_PROC=y
CONFIG_CGROUPS=y
CONFIG_CGROUP_SCHED=y
CONFIG_NAMESPACES=y
# CONFIG_UTS_NS is not set
# CONFIG_PID_NS is not set
CONFIG_BLK_DEV_INITRD=y
CONFIG_EXPERT=y
# CONFIG_SYSFS_SYSCALL is not set
CONFIG_KALLSYMS_ALL=y
# CONFIG_RSEQ is not set
# CONFIG_COMPAT_BRK is not set
# CONFIG_SLAB_MERGE_DEFAULT is not set
CONFIG_PROFILING=y
CONFIG_SCHED_MC=y
CONFIG_NR_CPUS=4
CONFIG_COMPAT=y
CONFIG_RANDOMIZE_BASE=y
# CONFIG_EFI is not set
CONFIG_PM_WAKELOCKS=y
CONFIG_PM_DEBUG=y
CONFIG_PM_ADVANCED_DEBUG=y
CONFIG_CPU_IDLE=y
CONFIG_ARM_PSCI_CPUIDLE=y
CONFIG_CPU_FREQ=y
CONFIG_CPU_FREQ_STAT=y
CONFIG_CPU_FREQ_TIMES=y
CONFIG_CPU_FREQ_GOV_POWERSAVE=y
CONFIG_CPU_FREQ_GOV_USERSPACE=y
CONFIG_CPU_FREQ_GOV_ONDEMAND=y
CONFIG_CPU_FREQ_GOV_CONSERVATIVE=y
CONFIG_MODULES=y
CONFIG_MODULE_UNLOAD=y
# CONFIG_CORE_DUMP_DEFAULT_ELF_HEADERS is not set
CONFIG_CMA=y
CONFIG_CMA_AREAS=16
CONFIG_NET=y
CONFIG_UNIX=y
CONFIG_INET=y
CONFIG_BT=y
CONFIG_BT_RFCOMM=y
CONFIG_BT_RFCOMM_TTY=y
CONFIG_BT_HCIUART=y
CONFIG_BT_HCIUART_H4=y
CONFIG_CFG80211=y
CONFIG_CFG80211_WEXT=y
CONFIG_MAC80211=y
CONFIG_RFKILL=y
CONFIG_PCI=y
# CONFIG_PCI_QUIRKS is not set
CONFIG_DEVTMPFS=y
CONFIG_DEVTMPFS_MOUNT=y
# CONFIG_ALLOW_DEV_COREDUMP is not set
CONFIG_SCSI=y
CONFIG_BLK_DEV_SD=y
CONFIG_SCSI_DEBUG=y
# CONFIG_WLAN_VENDOR_ADMTEK is not set
# CONFIG_WLAN_VENDOR_ATH is not set
# CONFIG_WLAN_VENDOR_ATMEL is not set
# CONFIG_WLAN_VENDOR_BROADCOM is not set
# CONFIG_WLAN_VENDOR_CISCO is not set
# CONFIG_WLAN_VENDOR_INTEL is not set
# CONFIG_WLAN_VENDOR_INTERSIL is not set
# CONFIG_WLAN_VENDOR_MARVELL is not set
# CONFIG_WLAN_VENDOR_MEDIATEK is not set
# CONFIG_WLAN_VENDOR_MICROCHIP is not set
# CONFIG_WLAN_VENDOR_RALINK is not set
# CONFIG_WLAN_VENDOR_REALTEK is not set
# CONFIG_WLAN_VENDOR_RSI is not set
# CONFIG_WLAN_VENDOR_ST is not set
# CONFIG_WLAN_VENDOR_TI is not set
# CONFIG_WLAN_VENDOR_ZYDAS is not set
# CONFIG_WLAN_VENDOR_QUANTENNA is not set
CONFIG_INPUT_EVDEV=y
# CONFIG_INPUT_MOUSE is not set
# CONFIG_SERIO_SERPORT is not set
# CONFIG_VT is not set
# CONFIG_LEGACY_PTYS is not set
CONFIG_SERIAL_8250=y
# CONFIG_SERIAL_8250_DEPRECATED_OPTIONS is not set
# CONFIG_SERIAL_8250_16550A_VARIANTS is not set
CONFIG_SERIAL_8250_CONSOLE=y
# CONFIG_SERIAL_8250_DMA is not set
# CONFIG_SERIAL_8250_EXAR is not set
CONFIG_SERIAL_8250_RUNTIME_UARTS=0
CONFIG_SERIAL_8250_DW=y
CONFIG_SERIAL_OF_PLATFORM=y
# CONFIG_HW_RANDOM is not set
# CONFIG_DEVPORT is not set
# CONFIG_PINCTRL_SUN50I_A100 is not set
# CONFIG_PINCTRL_SUN50I_A100_R is not set
# CONFIG_HWMON is not set
CONFIG_THERMAL_STATISTICS=y
CONFIG_THERMAL_WRITABLE_TRIPS=y
CONFIG_THERMAL_GOV_USER_SPACE=y
CONFIG_CPU_THERMAL=y
CONFIG_THERMAL_EMULATION=y
CONFIG_MFD_SYSCON=y
CONFIG_REGULATOR_FIXED_VOLTAGE=y
# CONFIG_MEDIA_CEC_SUPPORT is not set
CONFIG_VIDEO_V4L2_SUBDEV_API=y
# CONFIG_VGA_ARB is not set
CONFIG_DRM=y
CONFIG_FB=y
CONFIG_SOUND=y
CONFIG_SND=y
CONFIG_SND_SOC=y
CONFIG_HID_BETOP_FF=y
CONFIG_USB=y
CONFIG_USB_EHCI_HCD=y
CONFIG_USB_OHCI_HCD=y
CONFIG_USB_STORAGE=y
CONFIG_USB_STORAGE_REALTEK=y
CONFIG_USB_STORAGE_DATAFAB=y
CONFIG_USB_STORAGE_FREECOM=y
CONFIG_USB_STORAGE_ISD200=y
CONFIG_USB_STORAGE_USBAT=y
CONFIG_USB_STORAGE_SDDR09=y
CONFIG_USB_STORAGE_SDDR55=y
CONFIG_USB_STORAGE_JUMPSHOT=y
CONFIG_USB_STORAGE_ALAUDA=y
CONFIG_USB_STORAGE_ONETOUCH=y
CONFIG_USB_STORAGE_KARMA=y
CONFIG_USB_STORAGE_CYPRESS_ATACB=y
CONFIG_USB_STORAGE_ENE_UB6250=y
CONFIG_USB_UAS=y
CONFIG_USB_GADGET=y
CONFIG_USB_CONFIGFS=y
CONFIG_USB_CONFIGFS_UEVENT=y
CONFIG_USB_CONFIGFS_MASS_STORAGE=y
CONFIG_USB_CONFIGFS_F_FS=y
CONFIG_USB_CONFIGFS_F_HID=y
CONFIG_USB_ROLE_SWITCH=y
CONFIG_MMC=y
CONFIG_MMC_HSQ=y
CONFIG_DMABUF_HEAPS=y
CONFIG_DMABUF_SYSFS_STATS=y
CONFIG_DMABUF_HEAPS_DEFERRED_FREE=y
CONFIG_DMABUF_HEAPS_PAGE_POOL=y
CONFIG_DMABUF_HEAPS_SYSTEM=y
CONFIG_DMABUF_HEAPS_CMA=y
# CONFIG_SUNXI_CCU is not set
# CONFIG_ARM_ARCH_TIMER_EVTSTREAM is not set
# CONFIG_FSL_ERRATUM_A008585 is not set
CONFIG_EXT4_FS=y
# CONFIG_DNOTIFY is not set
CONFIG_AUTOFS4_FS=y
CONFIG_MSDOS_FS=y
CONFIG_VFAT_FS=y
CONFIG_TMPFS=y
CONFIG_TMPFS_POSIX_ACL=y
# CONFIG_MISC_FILESYSTEMS is not set
CONFIG_NLS_CODEPAGE_437=y
CONFIG_NLS_ISO8859_1=y
CONFIG_CRYPTO_USER=y
CONFIG_CRYPTO_ARC4=m
CONFIG_CRYPTO_USER_API_HASH=y
CONFIG_DMA_CMA=y
CONFIG_PRINTK_TIME=y
CONFIG_MESSAGE_LOGLEVEL_DEFAULT=7
CONFIG_DEBUG_INFO=y
# CONFIG_SECTION_MISMATCH_WARN_ONLY is not set
CONFIG_MAGIC_SYSRQ=y
CONFIG_DEBUG_FS=y
CONFIG_PANIC_ON_OOPS=y
# CONFIG_SCHED_DEBUG is not set
# CONFIG_DEBUG_PREEMPT is not set
CONFIG_STACKTRACE=y
# CONFIG_FTRACE is not set
```

## bsp/Kconfig
```kconfig
# SPDX-License-Identifier: GPL-2.0

menu "Allwinner BSP"

source "bsp/platform/Kconfig"
source "bsp/drivers/Kconfig"

endmenu
```

## bsp/drivers/Kconfig
```kconfig
# SPDX-License-Identifier: GPL-2.0-only

# Minimal System
menu "Device Drivers"
source "bsp/drivers/clk/Kconfig"
source "bsp/drivers/pinctrl/Kconfig"
source "bsp/drivers/uart/Kconfig"
source "bsp/drivers/timer/Kconfig"

# Basic System
source "bsp/drivers/dma/Kconfig"
source "bsp/drivers/rtc/Kconfig"
source "bsp/drivers/bus/Kconfig"
source "bsp/drivers/dumpreg/Kconfig"
source "bsp/drivers/watchdog/Kconfig"
source "bsp/drivers/i2c/Kconfig"
source "bsp/drivers/spi/Kconfig"
source "bsp/drivers/ledc/Kconfig"
source "bsp/drivers/pwm/Kconfig"
source "bsp/drivers/ir-tx/Kconfig"
source "bsp/drivers/ir-rx/Kconfig"
source "bsp/drivers/gpadc/Kconfig"
source "bsp/drivers/lradc/Kconfig"
source "bsp/drivers/rtp/Kconfig"
source "bsp/drivers/usb/Kconfig"
source "bsp/drivers/iommu/Kconfig"
source "bsp/drivers/emac/Kconfig"
source "bsp/drivers/gmac/Kconfig"
source "bsp/drivers/mbus/Kconfig"
source "bsp/drivers/msgbox/Kconfig"
source "bsp/drivers/hwspinlock/Kconfig"

# Power Management
source "bsp/drivers/irqchip/Kconfig"
source "bsp/drivers/standby/Kconfig"
source "bsp/drivers/thermal/Kconfig"
source "bsp/drivers/nvmem/Kconfig"
source "bsp/drivers/pm_domain/Kconfig"
source "bsp/drivers/power/Kconfig"
source "bsp/drivers/cpufreq/Kconfig"
source "bsp/drivers/devfreq/Kconfig"

# Input
source "bsp/drivers/input/Kconfig"

# Storage
source "bsp/drivers/mmc/Kconfig"

# Graphics
source "bsp/drivers/video/Kconfig"
source "bsp/drivers/g2d/Kconfig"
source "bsp/drivers/di/Kconfig"
source "bsp/drivers/vin/Kconfig"
source "bsp/drivers/vfe/Kconfig"
source "bsp/drivers/tvd/Kconfig"

# Multi-Media
source "bsp/drivers/ve/Kconfig"

# Sound
source "bsp/drivers/sound/Kconfig"

# Security
source "bsp/drivers/smc/Kconfig"
source "bsp/drivers/sid/Kconfig"
source "bsp/drivers/secure_storage/Kconfig"

# Net
source "bsp/drivers/net/Kconfig"

# Wireless
source "bsp/drivers/bluetooth/Kconfig"

# Misc
source "bsp/drivers/misc/Kconfig"

# Drm
source "bsp/drivers/drm/Kconfig"

# Drm heap
source "bsp/drivers/drm_heap/Kconfig"
# Vendor Hoosk
source "bsp/drivers/vendor_hooks/Kconfig"

# Crashdump
source "bsp/drivers/crashdump/Kconfig"

# ATA
source "bsp/drivers/ata/Kconfig"

# MTD
source "bsp/drivers/mtd/Kconfig"

# Remoteproc
source "bsp/drivers/remoteproc/Kconfig"

# Open source GPU
source "bsp/drivers/gpu/panfrost/Kconfig"

endmenu
```

## bsp/drivers/bluetooth/Kconfig
```kconfig
menu "Networking Drivers"

menu "Bluetooth Subsystem Support"

menu "Bluetooth Device Drivers"
	depends on AW_BSP
	depends on BT

config BCM_BT_LPM
	tristate "Broadcom Bluetooth Low Power Manager Support"
	help
	  Bluetooth Low Power Manager Driver.
	  This driver provides the dynamic active power saving mechanism for
	  bluetooth radio devices special for android4.2.

	  Say Y here to compile support for bt lmp support into the kernel
	  or say M to compile it as module (btlmp).

config RTL_BT_LPM
	tristate "Realtek Bluesleep driver support"
	help
	  Bluetooth Bluesleep Driver.
	  This driver provides the dynamic active power saving mechanism for
	  bluetooth radio devices.

	  Say Y here to compile support for bluesleep support into the kernel
	  or say M to compile it as module (bluesleep).

config XR_BT_LPM
	tristate "Xradio Bluetooth sleep driver support"
	help
	  Bluetooth Bluetooth sleep Driver.
	  This driver provides the dynamic active power saving mechanism for
	  bluetooth radio devices.

	  Say Y here to compile support for bluesleep support into the kernel
	  or say M to compile it as module (bluesleep).

config BT_RTKBTUSB
	tristate "RTK HCI USB driver"
	depends on USB
	help
	  RTK Bluetooth HCI USB driver

endmenu

endmenu

endmenu
```

## bsp/drivers/bus/Kconfig
```kconfig
# SPDX-License-Identifier: GPL-2.0-only
menu "Bus Drivers"
	depends on AW_BSP

config AW_NSI
	tristate "NSI Bus Support for Allwinner SoCs"
	depends on AW_BSP
	help
	  Support the NSI bus driver for Allwinner platforms.

endmenu
```

## bsp/drivers/clk/Kconfig
```kconfig
# SPDX-License-Identifier: GPL-2.0-only
menu "Clock Drivers"
	depends on AW_BSP

config AW_CCU
	tristate "Clock Support for Allwinner SoCs"
	depends on AW_BSP
	default y
	select RESET_CONTROLLER
	select AW_RTC_CCU

config AW_CCU_DEBUG
	tristate "DebugFS representation of clock tree"
	default AW_CCU
	depends on DEBUG_FS

config AW_SUN8IW11_CCU
	tristate "SUN8IW11 CCU"
	default ARCH_SUN8IW11
	depends on AW_CCU

config AW_SUN8IW18_CCU
	tristate "SUN8IW18 CCU"
	default ARCH_SUN8IW18
	depends on AW_CCU

config AW_SUN8IW20_CCU
	tristate "SUN8IW20 CCU"
	default ARCH_SUN8IW20
	depends on AW_CCU

config AW_SUN8IW20_R_CCU
	tristate "SUN8IW20 PRCM CCU"
	default ARCH_SUN8IW20
	depends on AW_CCU

config AW_SUN50IW12_CCU
	tristate "SUN50IW12 CCU"
	default ARCH_SUN50IW12
	depends on AW_CCU

config AW_SUN50IW12_R_CCU
	tristate "SUN50IW12 PRCM CCU"
	default ARCH_SUN50IW12
	depends on AW_CCU

config AW_SUN50IW10_CCU
	tristate "SUN50IW10 CCU"
	default ARCH_SUN50IW10
	depends on AW_CCU

config AW_SUN50IW10_R_CCU
	tristate "SUN50IW10 PRCM CCU"
	default ARCH_SUN50IW10
	depends on AW_CCU

config AW_SUN50IW10_DDR_CCU
	tristate "SUN50IW10_DDR_CCU"
	default ARCH_SUN50IW10
	depends on AW_CCU

config AW_SUN50IW10_DISPLL
	tristate "Support for the Allwinner SUN50IW10 DISPLL"
	default ARCH_SUN50IW10
	depends on AW_CCU

config AW_SUN50IW9_CCU
	tristate "SUN50IW9 CCU"
	default ARCH_SUN50IW9
	depends on AW_CCU

config AW_SUN50IW9_R_CCU
	tristate "SUN50IW9 PRCM CCU"
	default ARCH_SUN50IW9
	depends on AW_CCU

config AW_SUN55IW3_CCU
	tristate "SUN55IW3 CCU"
	default ARCH_SUN55IW3
	depends on AW_CCU

config AW_SUN55IW3_R_CCU
	tristate "SUN55IW3 PRCM CCU"
	default ARCH_SUN55IW3
	depends on AW_CCU

config AW_SUN55IW3_DSP_CCU
	tristate "SUN55IW3_DSP_CCU"
	default ARCH_SUN55IW3
	depends on AW_CCU

config AW_SUN55IW2_CCU
	tristate "SUN55IW2 CCU"
	default ARCH_SUN55IW2
	depends on AW_CCU

config AW_RTC_CCU
	tristate "RTC domain clocks"
	default y
	help
	  sunxi clock provider in RTC domain, which provides clocks such as
	  dcxo24M-out, iosc, osc32k, osc32k-out and rtc-1k. This module is
	  mandatory for sunxi SoCs. Say 'Y' here.

endmenu
```

## bsp/drivers/crashdump/Kconfig
```kconfig
# SPDX-License-Identifier: GPL-2.0-only

menu "CRASHDUMP Drivers"
	depends on AW_BSP

config AW_CRASHDUMP
	tristate "Allwinner Crash Dump Support"
	depends on ARCH_SUN8I || ARCH_SUN50I
	default n
	help
	  Say Y here to enable the sunxi crash dump support.
	  sunxi dump help to dump all dram area for crash tool.

endmenu
```

## bsp/drivers/devfreq/event/Kconfig
```kconfig
# SPDX-License-Identifier: GPL-2.0-only
#
# Devfreq device configuration
#

menu "Devfreq Device Event Drivers"
	depends on AW_BSP

config AW_EVENT_DFI
	tristate "ALLWINNER DFI DEVFREQ event Driver"
	help
	  This add the devfreq-event driver for Allwinner SoC. It provides DFI
	  (DDR Monitor Module) driver to count ddr load.

endmenu
```

## bsp/drivers/di/Kconfig
```kconfig
# SPDX-License-Identifier: GPL-2.0
menu "DI_Drivers"
	depends on AW_BSP

config AW_DI
	bool "DI Support for Allwinner SoCs"
	default n
	help
	  Enable sunxi platform De-Interlace engine

config SUNXI_DI_V1XX
	bool "Support DI V110/120"
	depends on (AW_DI)
	default n
	help
	 Say Y here if you want to use DI110/120.
	 Say N here if you do NOT want to use DI110/120.
	 If unsure, say N.

config SUNXI_DI_V2X
	bool "Support DI V200"
	depends on (AW_DI)
	default n
	help
	 Say Y here if you want to use DI200.
	 Say N here if you do NOT want to use DI200.
	 If unsure, say N.

config SUNXI_DI_V3X
	bool "Support DI V300"
	depends on (AW_DI)
	default n
	help
	 Say Y here if you want to use DI300.
	 Say N here if you do NOT want to use DI300.
	 If unsure, say N.

config SUNXI_DI_SINGEL_FILE
	bool "Support Single File"
	depends on (SUNXI_DI_V3X)
	default n
	help
	 Say Y here if you want to use Single File.
	 Say N here if you do NOT want to use Single File.
	 If unsure, say N.

endmenu
```
