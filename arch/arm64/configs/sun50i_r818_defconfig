## bsp/drivers/remoteproc/Kconfig
```kconfig
# SPDX-License-Identifier: GPL-2.0-only
#
# Allwinner remoteproc driver.
#
menu "Remoteproc drivers"
	depends on AW_BSP

config AW_REMOTEPROC
	tristate "Remoteproc Support for Allwinner SoCs"
	depends on AW_BSP
	select REMOTEPROC
	select MAILBOX
	help
	  allwinner

choice
	prompt "Allwinner remoteproc boot select"
config AW_REMOTEPROC_HIFI4_BOOT
	tristate "Allwinner remoteproc hifi4 boot"
	depends on AW_REMOTEPROC
	help
	  Say y here to support Allwinner SOC processors hifi4 via
	  remote processor framework.

config AW_REMOTEPROC_E906_BOOT
	tristate "Allwinner remoteproc e906 boot"
	depends on AW_REMOTEPROC
	help
	  Say y here to support Allwinner SOC processors e906 via
	  remote processor framework.
endchoice

endmenu
```

## bsp/drivers/rtc/Kconfig
```kconfig
# SPDX-License-Identifier: GPL-2.0-only

menu "RTC Drivers"
	depends on AW_BSP

config AW_RTC
	tristate "RTC Support for Allwinner SoCs"
	depends on AW_BSP
	select RTC_CLASS
	help
	  If you say Y here, you will get support for the RTC found on
	  Allwinner SoCs.

config AW_RTC_REBOOT_FLAG
	depends on AW_RTC
	bool "Enable RTC General Registers for Reboot Flag"
	help
	  Allow reboot app in userspace (such as Android reboot) to save
	  a flag in the RTC General Purpose Register. The flag could be read
	  by u-boot, kernel or user app after rebooting.

config AW_RTC_POWEROFF_ALARM
	depends on AW_RTC
	bool "Enable RTC Alarm in Power-Off State"
	help
	  Support RTC alarm when the system is Powered-Off.

endmenu
```

## bsp/drivers/sound/codecs/Kconfig
```kconfig
# SPDX-License-Identifier: GPL-2.0-or-later
#
# Allwinner audio codecs driver Kconfig
#
# Copyright(c) 2022-2027 Allwinnertech Co., Ltd.

menu "CODEC drivers"

config SND_SOC_AC107
	tristate "Allwinner AC107 CODEC"
	depends on I2C
	default n
	help
	  Enable support for the Allwinner AC107 CODEC.
	  The device provides a I2S/TDM/PDM interface for audio data
	  and a standard I2C interface for control data communication.
	  Select this if your sound card has AC107.

endmenu
```

## bsp/drivers/sound/platform/Kconfig
```kconfig
# SPDX-License-Identifier: GPL-2.0-or-later
#
# Allwinner audio platform driver Kconfig
#
# Copyright(c) 2022-2027 Allwinnertech Co., Ltd.

# Components for one
config SND_SOC_SUNXI_JACK
	tristate

# common
config SND_SOC_SUNXI_PCM
	tristate

config SND_SOC_SUNXI_MACH
	tristate

# ahub dam
config SND_SOC_SUNXI_AHUB_DAM
	tristate

# codec
config SND_SOC_SUNXI_SUNXI_DUMMYCODEC
	tristate

config SND_SOC_SUNXI_INTERNALCODEC
	tristate

config SND_SOC_SUNXI_SUN50IW10_CODEC
	tristate

config SND_SOC_SUNXI_SUN50IW9_CODEC
	tristate

config SND_SOC_SUNXI_SUN8IW11_CODEC
	tristate

# menu select
menu "Platform drivers"
	depends on ARCH_SUNXI

# aaudio
config SND_SOC_SUNXI_AAUDIO
	tristate "Allwinner AAUDIO support"
	select REGMAP_MMIO
	select SND_SOC_GENERIC_DMAENGINE_PCM
	select SND_SOC_SUNXI_PCM
	select SND_SOC_SUNXI_MACH
	select SND_SOC_SUNXI_INTERNALCODEC
	select SND_SOC_SUNXI_JACK
	select SND_SOC_SUNXI_SUN50IW10_CODEC if ARCH_SUN50IW10
	select SND_SOC_SUNXI_SUN50IW9_CODEC if ARCH_SUN50IW9
	select SND_SOC_SUNXI_SUN8IW11_CODEC if ARCH_SUN8IW11
	depends on ARCH_SUN50IW10 \
		|| ARCH_SUN50IW9  \
		|| ARCH_SUN8IW11
	help
	  Select Y or M to support analog-audio Module in the Allwinner SoCs.

choice
	prompt "jack detection method"
	depends on SND_SOC_SUNXI_AAUDIO
	help
	  Select the jack det method of audiocodec

config SND_SOC_SUNXI_JACK_NONE
	bool "none"
config SND_SOC_SUNXI_JACK_CODEC
	bool "internal codec"
	depends on ARCH_SUN50IW10
config SND_SOC_SUNXI_JACK_EXTCON
	bool "extcon"
endchoice

# spdif
config SND_SOC_SUNXI_SPDIF
	tristate "Allwinner SPDIF Support"
	select REGMAP_MMIO
	select SND_SOC_GENERIC_DMAENGINE_PCM
	select SND_SOC_SUNXI_PCM
	select SND_SOC_SUNXI_MACH
	depends on ARCH_SUN50IW10 \
		|| ARCH_SUN50IW9  \
		|| ARCH_SUN8IW11
	help
	  Select Y or M to support SPDIF Module in Allwinner SoCs.

# spdif for RX IEC61937
config SND_SOC_SUNXI_SPDIF_RXIEC61937
	tristate "Allwinner SPDIF RX IEC61937 Support"
	default y
	depends on SND_SOC_SUNXI_SPDIF
	depends on !ARCH_SUN50IW10 && !ARCH_SUN50IW9
	help
	  Select Y or M to support SPDIF RX IEC61937 in Allwinner SoCs.

# dmic
config SND_SOC_SUNXI_DMIC
	tristate "Allwinner DMIC support"
	select REGMAP_MMIO
	select SND_SOC_GENERIC_DMAENGINE_PCM
	select SND_SOC_SUNXI_PCM
	select SND_SOC_SUNXI_MACH
	depends on ARCH_SUN50IW10 \
		|| ARCH_SUN50IW9
	help
	  Select Y or M to support DMIC Module in Allwinner SoCs.

# daudio
config SND_SOC_SUNXI_DAUDIO
	tristate "Allwinner DAUDIO Support"
	select REGMAP_MMIO
	select SND_SOC_GENERIC_DMAENGINE_PCM
	select SND_SOC_SUNXI_PCM
	select SND_SOC_SUNXI_MACH
	depends on ARCH_SUN50IW10 \
		|| ARCH_SUN8IW11
	help
	  Select Y or M to support I2S/PCM/TDM Module in Allwinner SoCs.

# HDMIAUDIO
if SND_SOC_SUNXI_DAUDIO
config SND_SOC_SUNXI_PCM_HDMI
	tristate "Allwinner HDMIAUDIO Support"
	depends on !ARCH_SUN50IW10
	help
	  Select Y or M to support hdmi audio in Allwinner SoCs.
endif

# ahub
config SND_SOC_SUNXI_AHUB
	tristate "Allwinner AHUB Support"
	select REGMAP_MMIO
	select SND_SOC_GENERIC_DMAENGINE_PCM
	select SND_SOC_SUNXI_PCM
	select SND_SOC_SUNXI_MACH
	select SND_SOC_SUNXI_AHUB_DAM
	depends on ARCH_SUN50IW9
	help
	  Select Y or M to support audio-hub Module in Allwinner SoCs.

# HDMIAUDIO
if SND_SOC_SUNXI_AHUB
config SND_SOC_SUNXI_PCM_HDMI
	tristate "Allwinner HDMIAUDIO Support"
	depends on ARCH_SUN50IW9
	help
	  Select Y or M to support hdmi audio in Allwinner SoCs.
endif

# Components for all
config SND_SOC_SUNXI_COMPONENTS
	tristate "Allwinner Function Components"
	depends on ARCH_SUN50IW10 \
		|| ARCH_SUN50IW9 \
		|| ARCH_SUN8IW11
	help
	  Select Y or M to support function components.

config SND_SOC_SUNXI_RXSYNC
	tristate "Components Rx Sync"
	depends on SND_SOC_SUNXI_COMPONENTS
	depends on ARCH_SUN50IW10
	help
	  Select Y or M to support rx sync components.

config SND_SOC_SUNXI_DEBUG
	tristate "Components Debug"
	depends on SND_SOC_SUNXI_COMPONENTS
	help
	  Select Y or M to support debug components.

endmenu
```

## bsp/drivers/spi/Kconfig
```kconfig
# SPDX-License-Identifier: GPL-2.0-only

menu "SPI Drivers"
	depends on AW_BSP

config AW_SPI
	tristate "SPI Support for Allwinner SoCs"
	depends on AW_BSP && OF
	select SPI
	help
	  Enable SPI controllers on Allwinner SoCs.

endmenu
```

## bsp/drivers/thermal/Kconfig
```kconfig
# SPDX-License-Identifier: GPL-2.0-only
menu "Thermal Drivers"
	depends on AW_BSP

config AW_THERMAL
	tristate "Allwinner Thermal Driver"
	depends on AW_BSP
	depends on HAS_IOMEM
	depends on NVMEM
	depends on OF
	select THERMAL
	help
	  Support for the sunxi thermal sensor driver into the Linux thermal
	  framework.

	  To compile this driver as a module, choose M here: the
	  module will be called sunxi-thermal.

endmenu
```
