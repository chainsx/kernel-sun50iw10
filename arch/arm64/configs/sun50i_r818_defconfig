## bsp/drivers/drm/Kconfig
```kconfig
# SPDX-License-Identifier: GPL-2.0-only
menu "DRM Drivers"
	depends on AW_BSP

config AW_DRM
	tristate "DRM Support for Allwinner SoCs"
	depends on DRM && AW_BSP
	select DRM_KMS_HELPER
	default n

config AW_DRM_IOMMU
	bool "Support IOMMU when used the sunxi drm driver"
	depends on AW_IOMMU
	default n
	help
		If you want use IOMMU function, select it.

config AW_DRM_DE_SUN50IW1
	bool "Support DE of sun50iw1"
	depends on AW_DRM
	default n
	help
		If you want use DE of R18 serials, select it.

config AW_DRM_DE_V2X
	bool "Support DE of Version 200"
	depends on AW_DRM
	default n
	help
		If you want use DE of Version 200, select it.

config AW_DRM_DE_V3X
	bool "Support DE of Version 300"
	depends on AW_DRM
	default n
	help
		If you want use DE of Version 300, select it.

config AW_DRM_DE_V33X
	bool "Support DE of Version 330"
	depends on AW_DRM
	default n
	help
		If you want use DE of Version 330, select it.

menuconfig AW_DRM_LCD
	bool "Support LCD Output"
	depends on AW_DRM
	default n
	help
		If you want lcd output for drm driver, select it.

config AW_DRM_LCD_DSI
	bool "Support LCD-DSI Output"
	depends on AW_DRM_LCD
	default n
	help
		If you want lcd-dsi output for drm driver, select it.

config AW_DRM_LCD_EDP
	bool "Support LCD-EDP Output"
	depends on AW_DRM_LCD
	default n
	help
		If you want lcd-edp output for drm driver, select it.

config AW_DRM_HDMI14
	bool "Support HDMI1.4 Output"
	depends on AW_DRM
	default n
	help
		If you want hdmi1.4 output for drm driver, select it.

config AW_RM_HDMI20
	bool "Support HDMI2.0 Output"
	depends on AW_DRM
	default n
	help
		If you want hdmi2.0 output for drm driver, select it.

config AW_DRM_TV
	bool "Support sunxi TV Output"
	depends on AW_DRM
	default n
	help
		If you want sunxi tv (CVBS, VGA and YPbPr) output for drm driver, select it.

config AW_DRM_BACKLIGHT
	bool "Support sunxi backlight"
	depends on AW_DRM
    select BACKLIGHT_CLASS_DEVICE
	default n
	help
		If you want sunxi backlight for drm driver, select it.

endmenu

source "bsp/drivers/drm/sunxi_device/lcd_panel/Kconfig"
```

## bsp/drivers/drm/sunxi_device/lcd_panel/Kconfig
```kconfig
# SPDX-License-Identifier: GPL-2.0-only
config LCD_SUPPORT_DEFAULT
	bool "LCD default panel"
	depends on DRM && AW_DRM && AW_DRM_LCD
	default n
	help
		If you want a default panel for display driver, select it.

config LCD_SUPPORT_GG1P4062UTSW
	bool "LCD support cpu_gg1p4062utsw panel"
	depends on DRM && AW_DRM && AW_DRM_LCD
	default n
	help
		If you want to support cpu_gg1p4062utsw panel for display driver, select it.

config LCD_SUPPORT_DX0960BE40A1
	bool "LCD support dx0960be40a1 panel"
	depends on DRM && AW_DRM && AW_DRM_LCD
	default n
	help
		If you want to support dx0960be40a1 panel for display driver, select it.

config LCD_SUPPORT_TFT720X1280
	bool "LCD support dx0960be40a1 panel"
	depends on DRM && AW_DRM && AW_DRM_LCD
	default n
	help
		If you want to support dx0960be40a1 panel for display driver, select it.

config LCD_SUPPORT_FD055HD003S
	bool "LCD support fd055hd003s panel"
	depends on DRM && AW_DRM && AW_DRM_LCD
	default n
	help
		If you want to support fd055hd003s panel for display driver, select it.

config LCD_SUPPORT_HE0801A068
	bool "LCD support he0801a068 panel(DSI)"
	depends on DRM && AW_DRM && AW_DRM_LCD && AW_DRM_LCD_DSI
	default n
	help
		If you want to support he0801a068 panel for display driver, select it.

config LCD_SUPPORT_ILI9341
	bool "LCD support ili9341 panel"
	depends on DRM && AW_DRM && AW_DRM_LCD
	default n
	help
		If you want to support ili9341 panel for display driver, select it.

config LCD_SUPPORT_LH219WQ1
	bool "LCD support LH219WQ1 panel"
	depends on DRM && AW_DRM && AW_DRM_LCD
	default n
	help
		If you want to support LH219WQ1 panel for display driver, select it.

config LCD_SUPPORT_LS029B3SX02
	bool "LCD support ls029b3sx02 panel"
	depends on DRM && AW_DRM && AW_DRM_LCD
	default n
	help
		If you want to support ls029b3sx02 panel for display driver, select it.

config LCD_SUPPORT_LT070ME05000
	bool "LCD support lt070me05000 panel"
	depends on DRM && AW_DRM && AW_DRM_LCD
	default n
	help
		If you want to support lt070me05000 panel for display driver, select it.

config LCD_SUPPORT_S6D7AA0X01
	bool "LCD support S6D7AA0X01 panel"
	depends on DRM && AW_DRM && AW_DRM_LCD
	default n
	help
		If you want to support S6D7AA0X01 panel for display driver, select it.

config LCD_SUPPORT_T27P06
	bool "LCD support t27p06 panel"
	depends on DRM && AW_DRM && AW_DRM_LCD
	default n
	help
		If you want to support t27p06 panel for display driver, select it.

config LCD_SUPPORT_TFT720x1280
	bool "LCD support tft720x1280 panel"
	depends on DRM && AW_DRM && AW_DRM_LCD
	default n
	help
		If you want to support tft720x1280 panel for display driver, select it.

config LCD_SUPPORT_WTQ05027D01
	bool "LCD support wtq05027d01 panel"
	depends on DRM && AW_DRM && AW_DRM_LCD
	default n
	help
		If you want to support wtq05027d01 panel for display driver, select it.

config LCD_SUPPORT_H245QBN02
	bool "LCD support H245QBN02 panel"
	depends on DRM && AW_DRM && AW_DRM_LCD
	default n
	help
		If you want to support H245QBN02 panel for display driver, select it.

config LCD_SUPPORT_ST7789V
	bool "LCD support ST7789V panel"
	depends on DRM && AW_DRM && AW_DRM_LCD
	default n
	help
		If you want to support ST7789V panel for display driver, select it.

config LCD_SUPPORT_ST7796S
	bool "LCD support ST7796S panel"
	depends on DRM && AW_DRM && AW_DRM_LCD
	default n
	help
		If you want to support ST7796S panel for display driver, select it.

config LCD_SUPPORT_ST7701S
	bool "LCD support ST7701S panel"
	depends on DRM && AW_DRM && AW_DRM_LCD
	default n
	help
		If you want to support ST7701S panel for display driver, select it.

config LCD_SUPPORT_T30P106
	bool "LCD support T30P106 panel"
	depends on DRM && AW_DRM && AW_DRM_LCD
	default n
	help
		If you want to support T30P106 panel for display driver, select it.

config LCD_SUPPORT_TO20T20000
	bool "LCD support TO20T20000 panel"
	depends on DRM && AW_DRM && AW_DRM_LCD
	default n
	help
		If you want to support TO20T20000 panel for display driver, select it.

config LCD_SUPPORT_FRD450H40014
	bool "LCD support FRD450H40014 panel"
	depends on DRM && AW_DRM && AW_DRM_LCD
	default n
	help
		If you want to support FRD450H40014 panel for display driver, select it.

config LCD_SUPPORT_S2003T46G
	bool "LCD support S2003T46G panel"
	depends on DRM && AW_DRM && AW_DRM_LCD
	default n
	help
		If you want to support S2003T46G panel for display driver, select it.

config LCD_SUPPORT_WILLIAMLCD
	bool "LCD support WilliamLcd panel"
	depends on DRM && AW_DRM && AW_DRM_LCD
	default n
	help
		If you want to support WilliamLcd panel for display driver, select it.

config LCD_SUPPORT_LQ101R1SX03
	bool "LCD support lq101r1sx03 panel"
	depends on DRM && AW_DRM && AW_DRM_LCD
	default n
	help
		If you want to support lq101r1sx03 panel for display driver, select it.

config LCD_SUPPORT_INET_DSI_PANEL
	bool "LCD support inet_dsi_panel panel"
	depends on DRM && AW_DRM && AW_DRM_LCD && AW_DRM_LCD_DSI
	default n
	help
		If you want to support inet_dsi_panel panel for display driver, select it.

config LCD_SUPPORT_KD101N51
	bool "LCD support kd101n51 panel(DSI)"
	depends on DRM && AW_DRM && AW_DRM_LCD && AW_DRM_LCD_DSI
	default n
	help
		If you want to support kd101n51 panel for display driver, select it.

config LCD_SUPPORT_BP101WX1
	bool "LCD support bp101wx1 panel(lvds)"
	depends on DRM && AW_DRM && AW_DRM_LCD
	default n
	help
		If you want to support bp101wx1 panel for display driver, select it.

config LCD_SUPPORT_JC0WS0081CM
	bool "LCD support jc0ws008lcm panel(DSI)"
	depends on DRM && AW_DRM && AW_DRM_LCD
	default n
	help
		If you want to support jc0ws008lcm panel for display driver, select it.
```

## bsp/drivers/i2c/Kconfig
```kconfig
# SPDX-License-Identifier: GPL-2.0-only
#
# I2C drivers configuration
#
menu "I2C Drivers"
	depends on AW_BSP

config AW_I2C
	tristate "I2C Support for Allwinner SoCs"
	depends on HAS_IOMEM && AW_DMA
	select I2C
	select I2C_CHARDEV
	help
	  If you say yes to this option, support will be included for the
	  I2C interface from Allwinner SoCs.

config LT8912B_MIPI
        tristate "LT8912B MIPI to HDMI Driver"
        depends on I2C
        help
          If you say yes to this option, support will be included for the SMB
          Host controller on Acer Labs Inc. (ALI) M1535 South Bridges.  The SMB
          controller is part of the 7101 device, which is an ACPI-compliant
          Power Management Unit (PMU).

          This driver can also be built as a module.  If so, the module
          will be called lt8912b_mipi.

endmenu
```

## bsp/drivers/input/ctp/Kconfig
```kconfig
# SPDX-License-Identifier: GPL-2.0-only
#
# Touchscreen driver configuration
#

menuconfig AW_INPUT_CTP
	bool "Touchscreens input device support"
	help
	  Say Y here, and a list of supported touchscreens will be displayed.
	  This option doesn't affect the kernel.

	  If unsure, say Y.

if AW_INPUT_CTP

source "bsp/drivers/input/ctp/gslx680new/Kconfig"
source "bsp/drivers/input/ctp/wacom_pen/Kconfig"
source "bsp/drivers/input/ctp/gt9xxnew/Kconfig"

endif #touch input device support
```

## bsp/drivers/mbus/Kconfig
```kconfig
# SPDX-License-Identifier: GPL-2.0-only

menu "MBUS Drivers"
	depends on AW_BSP

config AW_MBUS_SUN50IW9
	tristate "Mbus Support for Allwinner SoCs SUN50IW9"
	depends on ARCH_SUN50IW9
	select HWMON
	help
	  Driver supporting the mbus for sunxi platforms of sun50iw9.

config AW_MBUS_SUN8IW11
	tristate "Mbus Support for Allwinner SoCs SUN8IW11"
	depends on ARCH_SUN8IW11
	select HWMON
	help
	  Driver supporting the mbus for sunxi platforms of sun8iw11.

endmenu
```

## bsp/drivers/mmc/Kconfig
```kconfig
# SPDX-License-Identifier: GPL-2.0-only
#
# MMC/SD host controller drivers
#

menu "SD/MMC Drivers"
	depends on AW_BSP

config AW_MMC_HSQ
	tristate "Allwinner SD/MMC SoftQueue Support"
       depends on MMC
       depends on !MMC_HSQ
       help
         This selects inplace SoftQueue Support

config AW_MMC
	tristate "Allwinner SD/MMC Host Controller Support"
	depends on MMC
	depends on MMC_HSQ || AW_MMC_HSQ

	help
	  This selects support for the SD/MMC Host Controller on
	  Allwinner SoCs.

config AW_MMC_V4P1X
	bool "V4P1X SD/MMC Host Controller Support"
	depends on AW_MMC
	default y
	help
	  V4P1X SD/MMC Host Contrller support.

config AW_MMC_V4P00X
	bool "V4P00X SD/MMC Host Controller Support"
	depends on AW_MMC
	default y
	help
	  V4P00X SD/MMC Host Contrller support.

config AW_MMC_V4P10X
	bool "V4P10X SD/MMC Host Controller Support"
	depends on AW_MMC
	default n
	help
	  V4P10X SD/MMC Host Contrller support.

config AW_MMC_V4P5X
	bool "V4P5X SD/MMC Host Controller Support"
	depends on AW_MMC
	default y
	help
	  V4P5X SD/MMC Host Contrller support.

config AW_MMC_V5P3X
	bool "V5P3X SD/MMC Host Controller Support"
	depends on AW_MMC
	default y
	help
	  V5P3X SD/MMC Host Contrller support.

config AW_MMC_DEBUG
	bool "SD/MMC Host Controller debug support"
	depends on AW_MMC
	default n
	help
	  AW SD/MMC Host Contrller debug support.

config AW_MMC_PRE_DBGLVL
        int "Pre-defined debug level for AW MMC driver"
	depends on AW_MMC && AW_MMC_DEBUG
	default 3

endmenu
```

## bsp/drivers/msgbox/Kconfig
```kconfig
# SPDX-License-Identifier: GPL-2.0-only

menu "MSGBOX Drivers"
	depends on AW_BSP

config AW_MSGBOX
	tristate "Msgbox support for Allwinner SoCs"
	depends on AW_BSP
	select  MAILBOX
	help
	  Say y here to support Allwinner SOC processors via the
	  msgbox framework.

endmenu
```

## bsp/drivers/mtd/hyperbus/Kconfig
```kconfig
menuconfig AW_MTD_HYPERBUS
	tristate "HyperBus support"
	depends on HAS_IOMEM
	select MTD_CFI
	select AW_MTD_MAP_BANK_WIDTH_2
	select MTD_CFI_AMDSTD
	select AW_MTD_COMPLEX_MAPPINGS
	help
	  This is the framework for the HyperBus which can be used by
	  the HyperBus Controller driver to communicate with
	  HyperFlash. See Cypress HyperBus specification for more
	  details

if AW_MTD_HYPERBUS

config AW_HBMC_AM654
	tristate "HyperBus controller driver for AM65x SoC"
	depends on ARM64 || COMPILE_TEST
	select MULTIPLEXER
	imply MUX_MMIO
	help
	 This is the driver for HyperBus controller on TI's AM65x and
	 other SoCs

config AW_RPCIF_HYPERBUS
	tristate "Renesas RPC-IF HyperBus driver"
	depends on RENESAS_RPCIF
	depends on MTD_CFI_BE_BYTE_SWAP
	help
	  This option includes Renesas RPC-IF HyperBus support.

endif # MTD_HYPERBUS
```

## bsp/drivers/pm_domain/Kconfig
```kconfig
# SPDX-License-Identifier: GPL-2.0-only
#
# Allwinner sunXi SoC drivers
#
menu "GPU Power Domain Drivers"
	depends on AW_BSP

config AW_GPU_PM_DOMAINS
	tristate "Allwinner GPU Power Domain"
	depends on PM
	select PM_GENERIC_DOMAINS
	select PM_GENERIC_DOMAINS_OF
	help
	 Say y here to enable power domain support.
	 In order to meet high performance and low power requirements, a power
	 management unit is designed or saving power when gpu in low power
	 mode. The PPU is dedicated for managing the power of the GPU.

	 If unsure, say N.

endmenu
```

## bsp/drivers/power/Kconfig
```kconfig
# SPDX-License-Identifier: GPL-2.0-only
#
# PMIC drivers configuration
#

menu "PMIC Drivers"
	depends on AW_BSP

config AW_MFD_AXP2101
	tristate
	select MFD_CORE
	select REGMAP_IRQ
	select HAS_IOMEM

config AW_MFD_AXP2101_I2C
	tristate "X-POWERS AXP2101 PMICs with I2C"
	select AW_MFD_AXP2101
	select REGMAP_I2C
	select I2C
	help
	  If you say Y here you get support for the X-Powers AXP2101 power
	  management ICs (PMICs) controlled with I2C.
	  This driver include only the core APIs. You have to select individual
	  components like regulators or the PEK (Power Enable Key) under the
	  corresponding menus.

config AW_MFD_PMU_EXT
	tristate
	select MFD_CORE
	select REGMAP
	select REGMAP_IRQ

config AW_MFD_PMU_EXT_I2C
	tristate "PMU_EXT PMICs with I2C"
	select AW_MFD_PMU_EXT
	select REGMAP_I2C
	select I2C
	help
	  If you say yes here you get support for the TCS4838 series of
	  PM chips with I2C interface.

comment "Regulator Drivers"

if AW_MFD_AXP2101

config AW_REGULATOR_AXP2101
	tristate "X-POWERS AXP2101 PMIC Regulators"
	depends on AW_MFD_AXP2101
	select REGULATOR
	select REGULATOR_VIRTUAL_CONSUMER
	help
	  This driver provides support for the voltage regulators on the
	  AXP2101 PMIC.
endif

if AW_MFD_PMU_EXT

config AW_REGULATOR_PMU_EXT
	tristate "PMU_EXT Power regulator"
	depends on AW_MFD_PMU_EXT
	select REGULATOR
	help
	  This driver provides support for the voltage regulators on the
	  PMU_EXT PMIC.

endif

comment "Powerkey Drivers"

if AW_MFD_AXP2101

config AW_INPUT_AXP2101_PEK
	tristate "X-POWERS AXP2101 Power Button Driver"
	depends on !UML
	depends on AW_MFD_AXP2101
	help
	  Say Y here if you want to enable power key reporting via the
	  AXP20X PMIC.

	  To compile this driver as a module, choose M here. The module will
	  be called axp2101-pek.

endif

comment "Power Supply Drivers"

if AW_MFD_AXP2101

config AW_AXP803_POWER
	tristate "AXP803 Power Supply Driver"
	select POWER_SUPPLY
	help
	  This driver provides support for the power supply features of
	  AXP803 PMIC.

config AW_AXP2202_POWER
	tristate "AXP2202 Power Supply Driver"
	select POWER_SUPPLY
	help
	  This driver provides support for the power supply features of
	  AXP2202 PMIC.

config AW_AXP2202_GPIO_POWER
	tristate "AXP2202 Power Virtual ACIN"
	select POWER_SUPPLY
	help
	  This driver provides support for ACIN function in
	  AXP2202 PMIC.

config AW_AXP22X_POWER
	tristate "AXP22X Power Supply Driver"
	select POWER_SUPPLY
	help
	  This driver provides support for the power supply features of
	  AXP221/AXP223 PMIC.
endif

endmenu
```
